## buildroot/linux/Config.in
```kconfig
source "$BR2_EXTERNAL_CUBE_PATH/package/setup/Config.in"
source "$BR2_EXTERNAL_CUBE_PATH/package/snpguest/Config.in"
```

## buildroot/linux/package/setup/Config.in
```kconfig
config BR2_PACKAGE_SETUP
    bool "setup"
    default y
	help
        This Setup package it used to setup the Docker environment used in the HAL
        It does the following:
            - Start networking
            - Mounts the rootfs.ext4 file system
            - Configure the docker daemon to use the rootfs.ext4 file system
```

## buildroot/linux/package/snpguest/Config.in
```kconfig
config BR2_PACKAGE_SNPGUEST
	bool "snpguest"
	default y
	depends on BR2_PACKAGE_HOST_RUSTC_TARGET_ARCH_SUPPORTS
	select BR2_PACKAGE_HOST_RUSTC
	help
	  snpguest is a CLI tool for interacting with SEV-SNP guest environment
	  https://github.com/virtee/snpguest
```

## hal/buildroot/linux/Config.in
```kconfig
menu "Cube AI Services"
	source "$BR2_EXTERNAL_CUBE_PATH/package/cube-agent/Config.in"
	source "$BR2_EXTERNAL_CUBE_PATH/package/ollama/Config.in"
	source "$BR2_EXTERNAL_CUBE_PATH/package/vllm/Config.in"
endmenu
```

## hal/buildroot/linux/configs/cube_defconfig
```kconfig
# Copyright (c) Ultraviolet
# SPDX-License-Identifier: Apache-2.0

# Architecture
BR2_x86_64=y

# System
BR2_TARGET_GENERIC_HOSTNAME="cube"
BR2_TARGET_GENERIC_ISSUE="Welcome to Cube AI"
BR2_PACKAGE_SYSTEMD_NETWORKD=y
BR2_PACKAGE_SYSTEMD_RESOLVED=y
BR2_INIT_SYSTEMD=y
BR2_SYSTEM_BIN_SH_BASH=y

# Filesystem
# BR2_TARGET_ROOTFS_TAR is not set
BR2_TARGET_ROOTFS_CPIO=y
BR2_TARGET_ROOTFS_CPIO_FULL=y
BR2_TARGET_ROOTFS_CPIO_GZIP=y
BR2_TARGET_ROOTFS_EXT2=y
BR2_TARGET_ROOTFS_EXT2_4=y
BR2_TARGET_ROOTFS_EXT2_SIZE="10G"

# Image
BR2_ROOTFS_OVERLAY="$(BR2_EXTERNAL_CUBE_PATH)/board/cube/overlay"
BR2_ROOTFS_POST_BUILD_SCRIPT="$(BR2_EXTERNAL_CUBE_PATH)/board/cube/post-build.sh"

# Image
BR2_ROOTFS_POST_IMAGE_SCRIPT="$(BR2_EXTERNAL_CUBE_PATH)/board/cube/post-image.sh"
BR2_ROOTFS_POST_SCRIPT_ARGS="$(BR2_DEFCONFIG)"

# Linux headers same as kernel
BR2_PACKAGE_HOST_LINUX_HEADERS_CUSTOM_6_11=y
BR2_TOOLCHAIN_HEADERS_AT_LEAST_6_10=y
BR2_TOOLCHAIN_HEADERS_AT_LEAST_6_11=y
BR2_TOOLCHAIN_HEADERS_LATEST=y
BR2_TOOLCHAIN_HEADERS_AT_LEAST="6.11"

# Kernel
BR2_LINUX_KERNEL=y
BR2_LINUX_KERNEL_CUSTOM_GIT=y
BR2_LINUX_KERNEL_CUSTOM_REPO_URL="https://git.kernel.org/pub/scm/linux/kernel/git/torvalds/linux.git"
BR2_LINUX_KERNEL_CUSTOM_REPO_VERSION="v6.11"
BR2_LINUX_KERNEL_VERSION="v6.11"
BR2_LINUX_KERNEL_PATCH=""
BR2_LINUX_KERNEL_USE_CUSTOM_CONFIG=y
BR2_LINUX_KERNEL_CUSTOM_CONFIG_FILE="$(BR2_EXTERNAL_CUBE_PATH)/board/cube/linux.config"
BR2_LINUX_KERNEL_NEEDS_HOST_LIBELF=y
BR2_LINUX_KERNEL_NEEDS_HOST_OPENSSL=y

# host-qemu for gitlab testing
BR2_PACKAGE_HOST_QEMU=y
BR2_PACKAGE_HOST_QEMU_SYSTEM_MODE=y

# Docker
BR2_PACKAGE_LIBSECCOMP_ARCH_SUPPORTS=y
BR2_PACKAGE_LIBSECCOMP=y
BR2_PACKAGE_CA_CERTIFICATES=y
BR2_PACKAGE_DOCKER_CLI=y
BR2_PACKAGE_DOCKER_COMPOSE=y
BR2_PACKAGE_DOCKER_ENGINE=y
BR2_PACKAGE_CONTAINERD=y
BR2_PACKAGE_RUNC=y
BR2_PACKAGE_IPTABLES=y

BR2_PACKAGE_GIT=y

BR2_PACKAGE_LIBCURL=y
BR2_PACKAGE_OPENSSL=y
BR2_PACKAGE_LIBOPENSSL=y
BR2_PACKAGE_LIBOPENSSL_BIN=y
BR2_PACKAGE_LIBRESSL_ARCH_SUPPORTS=y
BR2_PACKAGE_HAS_OPENSSL=y
BR2_PACKAGE_PROVIDES_OPENSSL="libopenssl"
BR2_PACKAGE_PROVIDES_HOST_OPENSSL="host-libopenssl"

BR2_PACKAGE_QUOTA=y
BR2_PACKAGE_QUOTATOOL=y

BR2_TARGET_GENERIC_PASSWD_SHA512=y
BR2_TARGET_GENERIC_PASSWD_METHOD="sha-512"

BR2_TARGET_ENABLE_ROOT_LOGIN=y
BR2_TARGET_GENERIC_ROOT_PASSWD="m2N2Lfno"

BR2_PACKAGE_HOST_MKPASSWD=y

BR2_PACKAGE_HTOP=y

# SSH
BR2_PACKAGE_OPENSSH=y
BR2_PACKAGE_OPENSSH_CLIENT=y
BR2_PACKAGE_OPENSSH_SERVER=y
BR2_PACKAGE_OPENSSH_KEY_UTILS=y
BR2_PACKAGE_OPENSSH_SANDBOX=y

# ==============================================================================
# Cube AI Services
# ==============================================================================

# Go toolchain (required for cube-agent and ollama)
BR2_PACKAGE_HOST_GO_TARGET_ARCH_SUPPORTS=y
BR2_PACKAGE_HOST_GO_TARGET_CGO_LINKING_SUPPORTS=y

# Cube Agent
BR2_PACKAGE_CUBE_AGENT=y
BR2_PACKAGE_CUBE_AGENT_INSTANCE_ID="cube-agent-01"
BR2_PACKAGE_CUBE_AGENT_HOST="0.0.0.0"
BR2_PACKAGE_CUBE_AGENT_PORT="7001"
BR2_PACKAGE_CUBE_AGENT_LOG_LEVEL="info"

# LLM Backend Selection (choose one)
# Default: Ollama
BR2_PACKAGE_CUBE_AGENT_BACKEND_OLLAMA=y
# BR2_PACKAGE_CUBE_AGENT_BACKEND_VLLM is not set
# BR2_PACKAGE_CUBE_AGENT_BACKEND_CUSTOM is not set
# BR2_PACKAGE_CUBE_AGENT_TARGET_URL="" (only used with BACKEND_CUSTOM)

# Ollama (enabled via cube-agent backend selection)
BR2_PACKAGE_OLLAMA=y
BR2_PACKAGE_OLLAMA_MODELS=y
# BR2_PACKAGE_OLLAMA_CUSTOM_MODELS="llama2:7b mistral:7b"
# BR2_PACKAGE_OLLAMA_GPU_SUPPORT is not set
# BR2_PACKAGE_OLLAMA_GPU_NVIDIA is not set
# BR2_PACKAGE_OLLAMA_GPU_AMD is not set

# vLLM Alternative (uncomment to use instead of Ollama)
# Note: Only enable ONE LLM backend at a time
# Also requires Python3 and PyTorch to be configured
# BR2_PACKAGE_VLLM is not set
# BR2_PACKAGE_VLLM_MODEL="microsoft/DialoGPT-medium"
# BR2_PACKAGE_VLLM_GPU_MEMORY="0.85"
# BR2_PACKAGE_VLLM_MAX_MODEL_LEN="1024"
# BR2_PACKAGE_VLLM_CUSTOM_MODEL_PATH=""

# Python3 (required for vLLM - uncomment if using vLLM)
# BR2_PACKAGE_PYTHON3=y
# BR2_PACKAGE_PYTHON_NUMPY=y
# BR2_PACKAGE_PYTHON_PYTORCH=y (needs to be available/configured)
# BR2_PACKAGE_PYTHON_TRANSFORMERS=y

# Additional utilities for debugging
BR2_PACKAGE_JQ=y
BR2_PACKAGE_PROCPS_NG=y

# ==============================================================================
# Configuration Notes:
# ==============================================================================
# 1. Cube Agent will start automatically and connect to the selected backend
# 2. Default backend: Ollama (http://localhost:11434)
# 3. Alternative backend: vLLM (http://localhost:8000)
# 4. To switch backends:
#    - Disable current backend option
#    - Enable desired backend option
#    - Rebuild with 'make clean && make'
# 5. Model installation:
#    - Ollama: Models pulled on first boot (see BR2_PACKAGE_OLLAMA_MODELS)
#    - vLLM: Downloaded from HuggingFace or use custom path
# 6. GPU support requires additional driver configuration
# ==============================================================================
```

## hal/buildroot/linux/package/agent/Config.in
```kconfig
config BR2_PACKAGE_CUBE_AGENT
	bool "cube-agent"
	depends on BR2_PACKAGE_HOST_GO_TARGET_ARCH_SUPPORTS
	depends on BR2_PACKAGE_HOST_GO_TARGET_CGO_LINKING_SUPPORTS
	help
	  Cube Agent - Ultraviolet Cube Agent for AI workloads

	  https://github.com/ultravioletrs/cube

if BR2_PACKAGE_CUBE_AGENT

config BR2_PACKAGE_CUBE_AGENT_INSTANCE_ID
	string "Agent Instance ID"
	default "cube-agent-01"
	help
	  Unique identifier for this agent instance

config BR2_PACKAGE_CUBE_AGENT_HOST
	string "Agent Host"
	default "0.0.0.0"
	help
	  Host address for the agent to bind to

config BR2_PACKAGE_CUBE_AGENT_PORT
	string "Agent Port"
	default "7001"
	help
	  Port for the agent to listen on

config BR2_PACKAGE_CUBE_AGENT_LOG_LEVEL
	string "Log Level"
	default "info"
	help
	  Logging level (debug, info, warn, error)

choice
	prompt "LLM Backend"
	default BR2_PACKAGE_CUBE_AGENT_BACKEND_OLLAMA
	help
	  Select the LLM backend to use

config BR2_PACKAGE_CUBE_AGENT_BACKEND_OLLAMA
	bool "Ollama"
	select BR2_PACKAGE_OLLAMA
	help
	  Use Ollama as the LLM backend

config BR2_PACKAGE_CUBE_AGENT_BACKEND_VLLM
	bool "vLLM"
	select BR2_PACKAGE_VLLM
	help
	  Use vLLM as the LLM backend

config BR2_PACKAGE_CUBE_AGENT_BACKEND_CUSTOM
	bool "Custom URL"
	help
	  Use a custom LLM backend URL

endchoice

config BR2_PACKAGE_CUBE_AGENT_TARGET_URL
	string "Custom Target URL"
	depends on BR2_PACKAGE_CUBE_AGENT_BACKEND_CUSTOM
	help
	  Custom LLM backend URL (e.g., http://192.168.1.100:8000)

endif

comment "cube-agent needs a toolchain w/ threads"
	depends on !BR2_TOOLCHAIN_HAS_THREADS
```

## hal/buildroot/linux/package/cube-agent/Config.in
```kconfig
config BR2_PACKAGE_CUBE_AGENT
	bool "cube-agent"
	depends on BR2_PACKAGE_HOST_GO_TARGET_ARCH_SUPPORTS
	depends on BR2_PACKAGE_HOST_GO_TARGET_CGO_LINKING_SUPPORTS
	help
	  Cube Agent - Ultraviolet Cube Agent for AI workloads

	  https://github.com/ultravioletrs/cube

if BR2_PACKAGE_CUBE_AGENT

config BR2_PACKAGE_CUBE_AGENT_INSTANCE_ID
	string "Agent Instance ID"
	default "cube-agent-01"
	help
	  Unique identifier for this agent instance

config BR2_PACKAGE_CUBE_AGENT_HOST
	string "Agent Host"
	default "0.0.0.0"
	help
	  Host address for the agent to bind to

config BR2_PACKAGE_CUBE_AGENT_PORT
	string "Agent Port"
	default "7001"
	help
	  Port for the agent to listen on

config BR2_PACKAGE_CUBE_AGENT_LOG_LEVEL
	string "Log Level"
	default "info"
	help
	  Logging level (debug, info, warn, error)

choice
	prompt "LLM Backend"
	default BR2_PACKAGE_CUBE_AGENT_BACKEND_OLLAMA
	help
	  Select the LLM backend to use

config BR2_PACKAGE_CUBE_AGENT_BACKEND_OLLAMA
	bool "Ollama"
	select BR2_PACKAGE_OLLAMA
	help
	  Use Ollama as the LLM backend

config BR2_PACKAGE_CUBE_AGENT_BACKEND_VLLM
	bool "vLLM"
	select BR2_PACKAGE_VLLM
	help
	  Use vLLM as the LLM backend

config BR2_PACKAGE_CUBE_AGENT_BACKEND_CUSTOM
	bool "Custom URL"
	help
	  Use a custom LLM backend URL

endchoice

config BR2_PACKAGE_CUBE_AGENT_TARGET_URL
	string "Custom Target URL"
	depends on BR2_PACKAGE_CUBE_AGENT_BACKEND_CUSTOM
	help
	  Custom LLM backend URL (e.g., http://192.168.1.100:8000)

config BR2_PACKAGE_CUBE_AGENT_OS_BUILD
	string "Agent OS Build"
	default "UVC"
	help
	  Build version of the OS running the agent

config BR2_PACKAGE_CUBE_AGENT_OS_DISTRO
	string "Agent OS Distro"
	default "UVC"
	help
	  Distribution of the OS running the agent

config BR2_PACKAGE_CUBE_AGENT_OS_TYPE
	string "Agent OS Type"
	default "UVC"
	help
	  Type of the OS running the agent

config BR2_PACKAGE_CUBE_AGENT_VMPL
	string "Agent VMPL"
	default "2"
	help
	  VM Privilege Level for the agent (default: 2)

config BR2_PACKAGE_CUBE_AGENT_CA_URL
	string "Agent CA URL"
	default ""
	help
	  URL of the Certificate Authority

config BR2_PACKAGE_CUBE_AGENT_ATTESTED_TLS
	bool "Enable Attested TLS"
	default y
	help
	  Enable Attested TLS for the agent server

config BR2_PACKAGE_CUBE_AGENT_SERVER_CA_CERTS
	string "Server CA Certificates File"
	default ""
	help
	  Path to the server CA certificates file

config BR2_PACKAGE_CUBE_AGENT_SERVER_CERT
	string "Server Certificate File"
	default ""
	help
	  Path to the server certificate file

config BR2_PACKAGE_CUBE_AGENT_SERVER_KEY
	string "Server Key File"
	default ""
	help
	  Path to the server key file

config BR2_PACKAGE_CUBE_AGENT_CLIENT_CA_CERTS
	string "Client CA Certificates File"
	default ""
	help
	  Path to the client CA certificates file

endif

comment "cube-agent needs a toolchain w/ threads"
	depends on !BR2_TOOLCHAIN_HAS_THREADS
```

## hal/buildroot/linux/package/ollama/Config.in
```kconfig
config BR2_PACKAGE_OLLAMA
	bool "ollama"
	depends on BR2_PACKAGE_HOST_GO_TARGET_ARCH_SUPPORTS
	depends on BR2_PACKAGE_HOST_GO_TARGET_CGO_LINKING_SUPPORTS
	select BR2_INSTALL_LIBSTDCPP
	help
	  Ollama - Get up and running with large language models locally

	  https://github.com/ollama/ollama

if BR2_PACKAGE_OLLAMA

config BR2_PACKAGE_OLLAMA_MODELS
	bool "Install default models"
	default y
	help
	  Automatically pull default models on first boot
	  (llama3.2:3b, starcoder2:3b, nomic-embed-text:v1.5)

config BR2_PACKAGE_OLLAMA_CUSTOM_MODELS
	string "Custom models to install"
	depends on BR2_PACKAGE_OLLAMA_MODELS
	help
	  Space-separated list of additional Ollama models to install
	  Example: "llama2:7b mistral:7b codellama:13b"

config BR2_PACKAGE_OLLAMA_GPU_SUPPORT
	bool "Enable GPU support"
	help
	  Enable GPU acceleration (requires appropriate drivers)

choice
	prompt "GPU Type"
	depends on BR2_PACKAGE_OLLAMA_GPU_SUPPORT
	default BR2_PACKAGE_OLLAMA_GPU_NVIDIA

config BR2_PACKAGE_OLLAMA_GPU_NVIDIA
	bool "NVIDIA GPU"
	help
	  Use NVIDIA GPU acceleration

config BR2_PACKAGE_OLLAMA_GPU_AMD
	bool "AMD GPU (ROCm)"
	help
	  Use AMD GPU acceleration with ROCm

endchoice

endif

comment "ollama needs a toolchain w/ threads, dynamic library"
	depends on !BR2_TOOLCHAIN_HAS_THREADS || BR2_STATIC_LIBS
```

## hal/buildroot/linux/package/vllm/Config.in
```kconfig
config BR2_PACKAGE_VLLM
	bool "vllm"
	depends on BR2_PACKAGE_PYTHON3
	depends on BR2_PACKAGE_PYTHON_PYTORCH
	help
	  vLLM - High-throughput and memory-efficient inference engine

	  https://github.com/vllm-project/vllm

if BR2_PACKAGE_VLLM

config BR2_PACKAGE_VLLM_MODEL
	string "Model to use"
	default "microsoft/DialoGPT-medium"
	help
	  HuggingFace model identifier to use with vLLM

config BR2_PACKAGE_VLLM_GPU_MEMORY
	string "GPU Memory Utilization"
	default "0.85"
	help
	  Fraction of GPU memory to use (0.0-1.0)

config BR2_PACKAGE_VLLM_MAX_MODEL_LEN
	string "Maximum Model Length"
	default "1024"
	help
	  Maximum sequence length for the model

config BR2_PACKAGE_VLLM_CUSTOM_MODEL_PATH
	string "Custom model path"
	help
	  Path to custom model files (leave empty to download from HuggingFace)
	  If specified, the model will be copied from this path

endif

comment "vllm needs python3 and pytorch"
	depends on !BR2_PACKAGE_PYTHON3 || !BR2_PACKAGE_PYTHON_PYTORCH
```
